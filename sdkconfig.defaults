## sdkconfig.defaults
```kconfig
# partitions
CONFIG_PARTITION_TABLE_CUSTOM=y
CONFIG_PARTITION_TABLE_CUSTOM_FILENAME="partitions.csv"
CONFIG_PARTITION_TABLE_FILENAME="partitions.csv"


# Button
CONFIG_IO_GLITCH_FILTER_TIME_MS=50
# end of Button



#
# Provisioning
#
# CONFIG_EXAMPLE_PROV_TRANSPORT_BLE is not set
CONFIG_EXAMPLE_PROV_TRANSPORT_SOFTAP=y
CONFIG_EXAMPLE_PROV_SECURITY_VERSION_1=y
# CONFIG_EXAMPLE_PROV_SECURITY_VERSION_2 is not set
CONFIG_EXAMPLE_PROV_TRANSPORT=2
# CONFIG_EXAMPLE_RESET_PROVISIONED is not set
CONFIG_EXAMPLE_RESET_PROV_MGR_ON_FAILURE=y
CONFIG_EXAMPLE_PROV_MGR_MAX_RETRY_CNT=5
# CONFIG_EXAMPLE_PROV_SHOW_QR is not set
CONFIG_EXAMPLE_PROV_USING_BLUEDROID=y
# end of Provisioning



CONFIG_ESP_SYSTEM_EVENT_QUEUE_SIZE=64
CONFIG_ESP_SYSTEM_EVENT_TASK_STACK_SIZE=5000
CONFIG_ESP_MAIN_TASK_STACK_SIZE=5000
# CONFIG_ESP_MAIN_TASK_AFFINITY_CPU0 is not set
CONFIG_ESP_MAIN_TASK_AFFINITY_NO_AFFINITY=y
CONFIG_ESP_MAIN_TASK_AFFINITY=0x7FFFFFFF
CONFIG_ESP_CONSOLE_SECONDARY_NONE=y
# CONFIG_ESP_CONSOLE_SECONDARY_USB_SERIAL_JTAG is not set

CONFIG_ESP32_WIFI_STATIC_RX_BUFFER_NUM=16

CONFIG_FREERTOS_IDLE_TASK_STACKSIZE=2304

# CONFIG_LOG_DEFAULT_LEVEL_INFO is not set
CONFIG_LOG_TIMESTAMP_SOURCE_SYSTEM=y


CONFIG_LWIP_SNTP_MAX_SERVERS=2
CONFIG_LWIP_DHCP_GET_NTP_SRV=y
CONFIG_LWIP_DHCP_MAX_NTP_SERVERS=2

CONFIG_MBEDTLS_CERTIFICATE_BUNDLE_MAX_CERTS=300

CONFIG_SYSTEM_EVENT_QUEUE_SIZE=64
CONFIG_SYSTEM_EVENT_TASK_STACK_SIZE=5000
CONFIG_MAIN_TASK_STACK_SIZE=5000
```
